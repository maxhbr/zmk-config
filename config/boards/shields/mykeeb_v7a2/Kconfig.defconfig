## config/boards/shields/mykeeb_v7a2/Kconfig.defconfig
```kconfig
# Copyright (c) 2022 The ZMK Contributors
# SPDX-License-Identifier: MIT

if SHIELD_MYKEEB_V7A2_LEFT

config ZMK_KEYBOARD_NAME
    default "mykeeb_v7a2"
    
config ZMK_SPLIT_ROLE_CENTRAL
    default y

endif

if SHIELD_MYKEEB_V7A2_LEFT || SHIELD_MYKEEB_V7A2_RIGHT

config ZMK_SPLIT
    default y

endif
```

## config/boards/shields/mykeeb_v7a2/Kconfig.shield
```kconfig
# Copyright (c) 2022 The ZMK Contributors
# SPDX-License-Identifier: MIT

config SHIELD_MYKEEB_V7A2_LEFT
    def_bool $(shields_list_contains,mykeeb_v7a2_left)

config SHIELD_MYKEEB_V7A2_RIGHT
    def_bool $(shields_list_contains,mykeeb_v7a2_right)
```

## config/boards/shields/mykeeb_v7a5/Kconfig.defconfig
```kconfig
# Copyright (c) 2022 The ZMK Contributors
# SPDX-License-Identifier: MIT

if SHIELD_MYKEEB_V7A5_LEFT

config ZMK_KEYBOARD_5AME
    default "mykeeb_v7a5"
    
config ZMK_SPLIT_ROLE_CENTRAL
    default y

endif

if SHIELD_MYKEEB_V7A5_LEFT || SHIELD_MYKEEB_V7A5_RIGHT

config ZMK_SPLIT
    default y

endif
```

## config/boards/shields/mykeeb_v7a5/Kconfig.shield
```kconfig
# Copyright (c) 2022 The ZMK Contributors
# SPDX-License-Identifier: MIT

config SHIELD_MYKEEB_V7A5_LEFT
    def_bool $(shields_list_contains,mykeeb_v7a5_left)

config SHIELD_MYKEEB_V7A5_RIGHT
    def_bool $(shields_list_contains,mykeeb_v7a5_right)
```

## config/boards/shields/settings_reset_xiao/Kconfig.defconfig
```kconfig
# Copyright (c) 2020 The ZMK Contributors
# SPDX-License-Identifier: MIT

if SHIELD_SETTINGS_RESET_XIAO

config ZMK_KEYBOARD_NAME
    default "SETTINGS RESET XIAO"

endif
```

## config/boards/shields/settings_reset_xiao/Kconfig.shield
```kconfig
# Copyright (c) 2020 The ZMK Contributors
# SPDX-License-Identifier: MIT

config SHIELD_SETTINGS_RESET_XIAO
    def_bool $(shields_list_contains,settings_reset_xiao)
```

## config/west.yml
```yaml
manifest:
  remotes:
    - name: zmkfirmware
      url-base: https://github.com/zmkfirmware
    - name: urob
      url-base: https://github.com/urob
  projects:
    - name: zmk
      ## use urobs fork until mouse support is merged
      # remote: zmkfirmware
      remote: urob 
      revision: main
      import: app/west.yml
  self:
    path: config
```
